// SPDX-License-Identifier: BSD-3-Clause
/*
 * Copyright (c) 2023 Qualcomm Innovation Center, Inc. All rights reserved.
 */

/dts-v1/;
/plugin/;

#include <dt-bindings/clock/qcom,gcc-sc7280.h>
#include <dt-bindings/clock/qcom,dispcc-sc7280.h>
#include <dt-bindings/interconnect/qcom,sc7280.h>
#include <dt-bindings/interrupt-controller/arm-gic.h>
#include <dt-bindings/power/qcom-rpmpd.h>
#include <dt-bindings/clock/qcom,rpmh.h>

#include "qcm6490-sde.dtsi"
#include "qcm6490-sde-display-rb3gen2.dtsi"

/ {
	model = "Qualcomm Technologies, Inc. QCM6490 RB3";
	compatible = "qcom,qcm6490-rb3", "qcom,qcm6490";
};
