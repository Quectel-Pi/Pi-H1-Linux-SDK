// SPDX-License-Identifier: BSD-3-Clause
/*
 * Copyright (c) 2023 Qualcomm Innovation Center, Inc. All rights reserved.
 */

&mdss_mdp0 {
	dsi_waveshare_8inch_video: qcom,mdss_dsi_waveshare_8inch_video {
		qcom,mdss-dsi-panel-name =
			"waveshare lcd video mode dsi panel without DSC";
		qcom,mdss-dsi-panel-type = "dsi_video_mode";
		qcom,dsi-ctrl-num = <0>;
		qcom,dsi-phy-num = <0>;
		qcom,mdss-dsi-virtual-channel-id = <0>;
		qcom,mdss-dsi-stream = <0>;
		qcom,mdss-dsi-bpp = <24>;
		qcom,mdss-dsi-border-color = <0>;
		qcom,mdss-dsi-traffic-mode = "burst_mode";
		qcom,mdss-dsi-bllp-power-mode;
		qcom,mdss-dsi-bllp-eof-power-mode;
		qcom,mdss-dsi-lane-0-state;
		qcom,mdss-dsi-lane-1-state;
		//qcom,mdss-dsi-lane-2-state;
		//qcom,mdss-dsi-lane-3-state;
		qcom,mdss-dsi-dma-trigger = "trigger_sw";
		qcom,mdss-dsi-mdp-trigger = "none";
		qcom,mdss-dsi-reset-sequence = <1 10>, <0 10>, <1 10>;
		qcom,mdss-dsi-tx-eot-append;
		qcom,adjust-timer-wakeup-ms = <1>;
		qcom,mdss-dsi-panel-hdr-enabled;
		qcom,mdss-dsi-panel-hdr-color-primaries = <39000 16000 33750
						 39800 13250 34450 7500 3000>;
		qcom,mdss-dsi-panel-peak-brightness = <6450000>;
		qcom,mdss-dsi-panel-blackness-level = <4961>;

		qcom,mdss-dsi-display-timings {
			timing@0 {
				cell-index = <0>;
				qcom,mdss-dsi-panel-width = <1280>;
				qcom,mdss-dsi-panel-height = <800>;
				qcom,mdss-dsi-h-front-porch = <20>;
				qcom,mdss-dsi-h-back-porch = <156>;
				qcom,mdss-dsi-h-pulse-width = <40>;
				qcom,mdss-dsi-h-sync-skew = <0>;
				qcom,mdss-dsi-v-back-porch = <48>;
				qcom,mdss-dsi-v-front-porch = <40>;
				qcom,mdss-dsi-v-pulse-width = <40>;
				qcom,mdss-dsi-panel-framerate = <60>;
			};
		};
	};
};
