// SPDX-License-Identifier: BSD-3-Clause
/*
 * Copyright (c) 2024 Qualcomm Innovation Center, Inc. All rights reserved.
 */
#include <dt-bindings/msm-camera.h>

&soc {
	qcom,cam-res-mgr {
		compatible = "qcom,cam-res-mgr";
		status = "ok";
	};
};

&cam_cci0 {

	/*cam0a-ov9282*/
	qcom,cam-sensor1 {
		cell-index = <20>;
		compatible = "qcom,cam-sensor";
		csiphy-sd-index = <0>;
		sensor-position-roll = <0>;
		sensor-position-pitch = <0>;
		sensor-position-yaw = <180>;
		cam_vio-supply = <&vreg_s4a>;
		regulator-names = "cam_vio";
		power-domains = <&camcc CAM_CC_TITAN_TOP_GDSC>;
		rgltr-cntrl-support;
		pwm-switch;
		rgltr-min-voltage = <1800000>;
		rgltr-max-voltage = <1800000>;
		rgltr-load-current = <120000>;
		gpio-no-mux = <0>;
		pinctrl-names = "cam_default", "cam_suspend";
		pinctrl-0 = <&cam_sensor_mclk0_active
		                &cam_sensor_active_rst0>;
		pinctrl-1 = <&cam_sensor_mclk0_suspend
		                &cam_sensor_suspend_rst0>;
		gpios = <&tlmm 72 0>,
			<&tlmm 132 0>,
			<&pmm8654au_0_gpios 7 0>;
		gpio-reset = <1>;
		gpio-custom1 = <2>;
		gpio-req-tbl-num = <0 1 2>;
		gpio-req-tbl-flags   	 = <1 0 0>;
		gpio-req-tbl-label = "CAM_MCLK0",
		                       "CAMIF_RESET0",
		                         "CAM_CUSTOM1";
		cci-master = <0>;
		clocks = <&camcc CAM_CC_MCLK0_CLK>;
		clock-names = "cam_clk";
		clock-cntl-level = "nominal";
		clock-rates = <24000000>;
		status = "ok";
	};

};

