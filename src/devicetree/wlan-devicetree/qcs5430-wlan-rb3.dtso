// SPDX-License-Identifier: BSD-3-Clause
/*
 * Copyright (c) 2024 Qualcomm Innovation Center, Inc. All rights reserved.
 */
/dts-v1/;
/plugin/;

#include <dt-bindings/clock/qcom,gcc-sc7280.h>
#include <dt-bindings/interconnect/qcom,sc7280.h>
#include <dt-bindings/interrupt-controller/arm-gic.h>
#include <dt-bindings/power/qcom-rpmpd.h>
#include "qcs5430-wlan-rb3.dtsi"

/ {
	model = "Qualcomm Technologies, Inc. qcs5430 rb3gen2 platform";
	compatible = "qcom,qcs5430-fp1-addons-rb3gen2",
			"qcom,qcs5430-fp1-addons-rb3gen2-vision-mezz",
			"qcom,qcs5430-fp1p5-addons-rb3gen2",
			"qcom,qcs5430-fp1p5-addons-rb3gen2-vision-mezz",
			"qcom,qcs5430-fp2-addons-rb3gen2",
			"qcom,qcs5430-fp2-addons-rb3gen2-vision-mezz",
			"qcom,qcs5430";
};
