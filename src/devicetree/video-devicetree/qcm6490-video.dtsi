// SPDX-License-Identifier: BSD-3-Clause
/*
 * Copyright (c) 2024 Qualcomm Innovation Center, Inc. All rights reserved.
 */

&venus {
	compatible = "qcom,qcm6490-iris-vpu";
	status = "okay";
	interconnect-names = "iris-cnoc", "iris-ddr";
	non-secure-cb {
		compatible = "qcom,vidc,cb-ns";
		iommus = <&apps_smmu 0x2180 0x20>;
	};
};
