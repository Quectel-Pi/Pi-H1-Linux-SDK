/*
 * Copyright (c) 2024 Qualcomm Innovation Center, Inc. All rights reserved.
 */
// SPDX-License-Identifier: BSD-3-Clause

#include "qcm6490-graphics.dtsi"

&msm_gpu {
	qcom,gpu-model = "Adreno642l";
};
