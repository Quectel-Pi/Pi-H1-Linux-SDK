## sources/quectel-src/kernel/qcom-6.6/Documentation/devicetree/bindings/clock/qcom,debugcc.yaml
```yaml
# SPDX-License-Identifier: (GPL-2.0-only OR BSD-2-Clause)
%YAML 1.2
---
$id: http://devicetree.org/schemas/clock/qcom,debugcc.yaml#
$schema: http://devicetree.org/meta-schemas/core.yaml#

title: Qualcomm Technologies, Inc. Debug Clock Controller

maintainers:
  - Imran Shaik <quic_imrashai@quicinc.com>
  - Taniya Das <quic_tdas@quicinc.com>

description: |
  Debug clock controller module used to read the clock measurement of
  other clock controller clocks.

properties:
  compatible:
    enum:
      - qcom,measure-debugcc-qcs8300
      - qcom,measure-debugcc-sa8775p

  clocks:
    items:
      - description: Board XO source
      - description: CAMCC clock source
      - description: DISPCC0 clock source
      - description: DISPCC1 clock source
      - description: GCC clock source
      - description: GPUCC clock source
      - description: VIDEOCC clock source

  clock-names:
    items:
      - const: xo_clk_src
      - const: camcc
      - const: dispcc0
      - const: dispcc1
      - const: gcc
      - const: gpucc
      - const: videocc

  qcom,apsscc:
    $ref: /schemas/types.yaml#/definitions/phandle
    description: phandle to the APSS CC device node

  qcom,camcc:
    $ref: /schemas/types.yaml#/definitions/phandle
    description: phandle to the Camera CC device node

  qcom,dispcc:
    $ref: /schemas/types.yaml#/definitions/phandle
    description: phandle to the Display CC device node

  qcom,gcc:
    $ref: /schemas/types.yaml#/definitions/phandle
    description: phandle to the GCC device node

  qcom,gpucc:
    $ref: /schemas/types.yaml#/definitions/phandle
    description: phandle to the GPU CC device node

  qcom,mccc:
    $ref: /schemas/types.yaml#/definitions/phandle
    description: phandle to the Memory Controller CC device node

  qcom,videocc:
    $ref: /schemas/types.yaml#/definitions/phandle
    description: phandle to the Video CC device node

required:
  - compatible
  - clocks
  - clock-names
  - qcom,gcc
  - qcom,apsscc
  - qcom,mccc

additionalProperties: true

examples:
  - |
    #include <dt-bindings/clock/qcom,rpmh.h>
    debugcc: qcom,cc-debug {
        compatible = "qcom,measure-debugcc-qcs8300";
        qcom,gcc = <&gcc>;
        qcom,gpucc = <&gpucc>;
        qcom,videocc = <&videocc>;
        qcom,dispcc = <&dispcc>;
        qcom,camcc = <&camcc>;
        qcom,apsscc = <&apsscc>;
        qcom,mccc = <&mccc>;
        clocks = <&rpmhcc RPMH_CXO_CLK>,
                 <&camcc 0>,
                 <&dispcc0 0>,
                 <&gcc 0>,
                 <&gpucc 0>,
                 <&videocc 0>;
        clock-names = "xo_clk_src",
                      "camcc",
                      "dispcc",
                      "gcc",
                      "gpucc",
                      "videocc";
        #clock-cells = <1>;
    };
...
```

## sources/quectel-src/kernel/qcom-6.6/Documentation/devicetree/bindings/crypto/qcom,inline-crypto-engine.yaml
```yaml
# SPDX-License-Identifier: (GPL-2.0-only OR BSD-2-Clause)
%YAML 1.2
---
$id: http://devicetree.org/schemas/crypto/qcom,inline-crypto-engine.yaml#
$schema: http://devicetree.org/meta-schemas/core.yaml#

title: Qualcomm Technologies, Inc. (QTI) Inline Crypto Engine

maintainers:
  - Bjorn Andersson <andersson@kernel.org>

properties:
  compatible:
    items:
      - enum:
          - qcom,sa7255p-inline-crypto-engine
          - qcom,sa8255p-inline-crypto-engine
          - qcom,sm8450-inline-crypto-engine
          - qcom,sm8550-inline-crypto-engine
          - qcom,sm8650-inline-crypto-engine
      - const: qcom,inline-crypto-engine

  reg:
    maxItems: 1

  clocks:
    maxItems: 1

  qcom,ice-use-hwkm:
    type: boolean
    description:
      Use the supported Hardware Key Manager (HWKM) in Qualcomm
      ICE to support wrapped keys. This dictates if wrapped keys
      have to be used by ICE.

  qcom,ice-skip-clk:
    type: boolean
    description:
      Skip to get GCC_UFS_PHY_ICE_CORE_CLK in ICE driver. This
      dictates if ICE driver request this clock on/off.

  operating-points-v2:
    description:
      Optional phandle to an OPP table node that defines supported ICE
      frequencies and required power states. If not present, driver will
      use fixed clock rate. The required-opps property in each OPP entry
      must reference valid power domain OPP entries (e.g., rpmhpd_opp_*).

  opp-table:
    type: object

required:
  - compatible
  - reg
  - oneof:
    - clocks
    - qcom,ice-skip-clk

additionalProperties: false

examples:
  - |
    #include <dt-bindings/clock/qcom,sm8550-gcc.h>

    crypto@1d88000 {
      compatible = "qcom,sm8550-inline-crypto-engine",
                   "qcom,inline-crypto-engine";
      reg = <0x01d88000 0x8000>;
      clocks = <&gcc GCC_UFS_PHY_ICE_CORE_CLK>;
      operating-points-v2 = <&ice_opp_table>;

      ice_opp_table: opp-table {
          compatible = "operating-points-v2";

          opp-201600000 {
              opp-hz = /bits/ 64 <201600000>;
              required-opps = <&rpmhpd_opp_svs_l1>;
          };

          opp-403200000 {
              opp-hz = /bits/ 64 <403200000>;
              required-opps = <&rpmhpd_opp_nom>;
          };
       };
    };

  - |
    crypto@1d88000 {
      compatible = "qcom,sa8255p-inline-crypto-engine",
                   "qcom,inline-crypto-engine",
      reg = <0x01d88000 0x8000>;
      qcom,ice-skip-clk;
      operating-points-v2 = <&ice_opp_table>;

      ice_opp_table: opp-table {
          compatible = "operating-points-v2";

          opp-201600000 {
              opp-hz = /bits/ 64 <201600000>;
              required-opps = <&rpmhpd_opp_svs_l1>;
          };

          opp-403200000 {
              opp-hz = /bits/ 64 <403200000>;
              required-opps = <&rpmhpd_opp_nom>;
          };
       };
    };
...
```

## sources/quectel-src/kernel/qcom-6.6/Documentation/devicetree/bindings/soc/qcom/qcom,nhlos-logs.yaml
```yaml
# SPDX-License-Identifier: (GPL-2.0-only OR BSD-2-Clause)
%YAML 1.2
---
$id: http://devicetree.org/schemas/soc/qcom/qcom,nhlos-logs.yaml#
$schema: http://devicetree.org/meta-schemas/core.yaml#

title: Qualcomm NHLOS log driver

maintainers:
  - Jai Kumar Gautam <jgautam@qti.qualcomm.com>

description: |
    This driver enables console access to logs from various Non HLOS subsystems
    which contain information about the firmware configuration currently set
    on the SoC. The logs are stored in predefined reserved memory regions.
properties:
  compatible:
    items:
      - enum:
          - qcom,nhlos-logs-mem
          - qcom,nhlos-logs-io
      - const: qcom,nhlos-logs

  memory-region:
    maxItems: 1
    description: Handle to reserved memory region.

required:
  - compatible
  - memory-region

additionalProperties: false

examples:
  - |
        reserved-memory {
            uefi_log_mem: uefi-log-mem@908b0000 {
                reg = <0x0 0x908b0000 0x0 0x10000>;
                no-map;
            };
        };

        soc {
            uefi_log {
                compatible = "qcom,nhlos-logs-mem", "qcom,nhlos-logs";
                memory-region = <&uefi_log_mem>;
            };
        };
```
