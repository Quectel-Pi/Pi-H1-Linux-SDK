## layers/meta-qcom-distro/conf/distro/qcom-wayland.conf
```bitbake
require conf/distro/include/qcom-base.inc

DISTRO_FEATURES:append = " wayland vulkan opengl"
```

## layers/meta-qcom-hwe/conf/machine/qcm6490-idp.conf
```bitbake
#@TYPE: Machine
#@NAME: qcm6490-idp
#@DESCRIPTION: Machine configuration for the IDP Beta Evaluation Kit (EVK), with Qualcomm QCM6490

require conf/machine/include/qcom-qcs6490.inc

MACHINE_FEATURES = "usbhost usbgadget alsa wifi bluetooth"

# This DT currently exist only as patches against linux-qcom-base recipe.
KERNEL_DEVICETREE:pn-linux-qcom-base = " \
                      qcom/qcm6490-idp.dtb \
                      "

KERNEL_DEVICETREE:pn-linux-qcom-custom = " \
                      qcom/qcm6490-addons-idp.dtb \
                      qcom/qcm6490-addons-idp-amoled.dtb \
                      "

KERNEL_DEVICETREE:pn-linux-qcom-custom = " \
                      qcom/qcs6490-idp-pi.dtb \
                      "

# qcm6490-camera-rb3.dtbo
KERNEL_TECH_DTBOS[qcs6490-idp-pi] = " \
    qcm6490-graphics.dtbo \
    qcm6490-display-pi.dtbo \
    qcm6490-camera-rb3.dtbo \
    qcm6490-video.dtbo \
    "

# qcm6490-camera-idp.dtbo
# Additional dtbo to overylay on top of kernel devicetree files
KERNEL_TECH_DTBOS[qcm6490-addons-idp] = " \
    qcm6490-graphics.dtbo qcm6490-display.dtbo \
    qcm6490-camera-idp.dtbo \
    qcm6490-wlan-idp.dtbo qcm6490-video.dtbo \
    qcm6490-wlan-upstream.dtbo \
    "

# qcm6490-camera-idp.dtbo
KERNEL_TECH_DTBOS[qcm6490-addons-idp-amoled] = " \
    qcm6490-graphics.dtbo qcm6490-display-idp-amoled.dtbo \
    qcm6490-camera-idp.dtbo \
    qcm6490-wlan-idp.dtbo qcm6490-video.dtbo \
    qcm6490-wlan-upstream.dtbo \
    "

# cameradtb
# Recipe providers of above dtbo files.
KERNEL_TECH_DTBO_PROVIDERS = "\
    cameradtb \
    qcom-displaydevicetree \
    qcom-graphicsdevicetree \
    qcom-videodtb \
    wlan-devicetree \
"
```

## sources/quectel-src/kernel/qcom-6.6/drivers/net/wireless/quectel/Kconfig
```kconfig
config QUECPI_WIRELESS
	tristate "Quectel QuecPI WEXT config"
	depends on CFG80211
	select WIRELESS_EXT
	select WEXT_SPY
	select WEXT_PRIV
	select BT
	select BT_LE
	select BT_BREDR
	select BT_HCIUART
	select BT_HCIUART_H4
	select BT_RFCOMM
	select BT_RFCOMM_TTY
	select USB_G_SERIAL
	help
		this config will enable Wext marco for fc2x device complie
```
