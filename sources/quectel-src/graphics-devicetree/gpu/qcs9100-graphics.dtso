/*
 * Copyright (c) 2024 Qualcomm Innovation Center, Inc. All rights reserved.
 */
// SPDX-License-Identifier: BSD-3-Clause

/dts-v1/;
/plugin/;

#include <dt-bindings/clock/qcom,sa8775p-gcc.h>
#include <dt-bindings/clock/qcom,sa8775p-gpucc.h>
#include <dt-bindings/interconnect/qcom,sa8775p-rpmh.h>
#include <dt-bindings/interrupt-controller/arm-gic.h>
#include <dt-bindings/power/qcom-rpmpd.h>

#include "qcs9100-graphics.dtsi"

/ {
	model = "Qualcomm SA8775P Ride";
	compatible = "qcom,sa8775p-ride", "qcom,sa8775p";
	qcom,msm-id = <533 0x10000>, <534 0x10000>, <534 0x20000>;
	qcom,board-id = <0x19 0>, <0x25 1>;
};
