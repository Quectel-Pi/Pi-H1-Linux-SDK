// SPDX-License-Identifier: BSD-3-Clause
/*
 * Copyright (c) 2024 Qualcomm Innovation Center, Inc. All rights reserved.
 */

#include "qcm6490-sde-display-idp.dtsi"

&dsi_r66451_amoled_120hz_video_cphy {
	qcom,panel-supply-entries = <&dsi_panel_pwr_supply_amoled>;
	qcom,mdss-dsi-bl-pmic-control-type = "bl_ctrl_dcs";
	qcom,mdss-dsi-bl-min-level = <1>;
	qcom,mdss-dsi-bl-max-level = <4095>;
	qcom,mdss-brightness-max-level = <255>;
	qcom,mdss-dsi-bl-inverted-dbv;
	qcom,platform-reset-gpio = <&tlmm 44 0>;
};

&sde_dsi {
	qcom,dsi-default-panel = <&dsi_r66451_amoled_120hz_video_cphy>;
	vddio-supply = <&vreg_l12c_1p65>;
	vdd-supply = <&vreg_l13c_2p7>;
};

&i2c13 {
	status = "disabled";
};
