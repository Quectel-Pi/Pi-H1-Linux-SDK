// SPDX-License-Identifier: BSD-3-Clause
/*
 * Copyright (c) 2024 Qualcomm Innovation Center, Inc. All rights reserved.
 */

/dts-v1/;
/plugin/;

#include "qcm6490-sde.dtsi"
#include "qcm6490-sde-display-idp-amoled.dtsi"
/ {
        model = "Qualcomm Technologies, Inc. QCM6490 IDP + AMOLED";
        compatible = "qcom,qcm6490-idp", "qcom,qcm6490";
};

