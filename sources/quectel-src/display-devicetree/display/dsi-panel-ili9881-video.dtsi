// SPDX-License-Identifier: BSD-3-Clause
/*
 * Copyright (c) 2023 Qualcomm Innovation Center, Inc. All rights reserved.
 */

&mdss_mdp0 {
	dsi_ili9881_video: qcom,mdss_dsi_ili9881_video {
		qcom,mdss-dsi-panel-name =
			"dsi_ili9881_video lcd video mode dsi novatek panel with DSC";
		qcom,mdss-dsi-panel-type = "dsi_video_mode";
		qcom,dsi-ctrl-num = <0>;
		qcom,dsi-phy-num = <0>;
		qcom,mdss-dsi-virtual-channel-id = <0>;
		qcom,mdss-dsi-stream = <0>;
		qcom,mdss-dsi-bpp = <24>;
		qcom,mdss-dsi-border-color = <0>;
		qcom,mdss-dsi-traffic-mode = "burst_mode";
		qcom,mdss-dsi-bllp-power-mode;
		qcom,mdss-dsi-bllp-eof-power-mode;
		qcom,mdss-dsi-lane-0-state;
		qcom,mdss-dsi-lane-1-state;
		//qcom,mdss-dsi-lane-2-state;
		//qcom,mdss-dsi-lane-3-state;
		qcom,mdss-dsi-dma-trigger = "trigger_sw";
		qcom,mdss-dsi-mdp-trigger = "none";
		qcom,mdss-dsi-reset-sequence = <1 10>, <0 10>, <1 10>;
		qcom,mdss-dsi-tx-eot-append;
		qcom,adjust-timer-wakeup-ms = <1>;
		qcom,mdss-dsi-panel-hdr-enabled;
		qcom,mdss-dsi-panel-hdr-color-primaries = <15000 16000 33750
						 15800 13250 34450 7500 3000>;
		qcom,mdss-dsi-panel-peak-brightness = <6450000>;
		qcom,mdss-dsi-panel-blackness-level = <4961>;

		qcom,mdss-dsi-display-timings {
			timing@0 {
				cell-index = <0>;
				qcom,mdss-dsi-panel-width = <720>;
				qcom,mdss-dsi-panel-height = <1280>;
				qcom,mdss-dsi-h-front-porch = <44>;
				qcom,mdss-dsi-h-back-porch = <30>;
				qcom,mdss-dsi-h-pulse-width = <20>;
				qcom,mdss-dsi-h-sync-skew = <0>;
				qcom,mdss-dsi-v-front-porch = <10>;
				qcom,mdss-dsi-v-back-porch = <10>;
				qcom,mdss-dsi-v-pulse-width = <10>;
				qcom,mdss-dsi-panel-framerate = <60>;

				qcom,mdss-dsi-on-command = [
					39 01 00 00 00 00 04 FF 98 81 03
					39 01 00 00 00 00 02 01 00
					39 01 00 00 00 00 02 02 00
					39 01 00 00 00 00 02 03 73
					39 01 00 00 00 00 02 04 00
					39 01 00 00 00 00 02 05 00
					39 01 00 00 00 00 02 06 0A
					39 01 00 00 00 00 02 07 00
					39 01 00 00 00 00 02 08 00
					39 01 00 00 00 00 02 09 61
					39 01 00 00 00 00 02 0A 00
					39 01 00 00 00 00 02 0B 00
					39 01 00 00 00 00 02 0C 01
					39 01 00 00 00 00 02 0D 00
					39 01 00 00 00 00 02 0E 00
					39 01 00 00 00 00 02 0F 61
					39 01 00 00 00 00 02 10 61
					39 01 00 00 00 00 02 11 00
					39 01 00 00 00 00 02 12 00
					39 01 00 00 00 00 02 13 00
					39 01 00 00 00 00 02 14 00
					39 01 00 00 00 00 02 15 00
					39 01 00 00 00 00 02 16 00
					39 01 00 00 00 00 02 17 00
					39 01 00 00 00 00 02 18 00
					39 01 00 00 00 00 02 19 00
					39 01 00 00 00 00 02 1A 00
					39 01 00 00 00 00 02 1B 00
					39 01 00 00 00 00 02 1C 00
					39 01 00 00 00 00 02 1D 00
					39 01 00 00 00 00 02 1E 40
					39 01 00 00 00 00 02 1F 80
					39 01 00 00 00 00 02 20 06
					39 01 00 00 00 00 02 21 01
					39 01 00 00 00 00 02 22 00
					39 01 00 00 00 00 02 23 00
					39 01 00 00 00 00 02 24 00
					39 01 00 00 00 00 02 25 00
					39 01 00 00 00 00 02 26 00
					39 01 00 00 00 00 02 27 00
					39 01 00 00 00 00 02 28 33
					39 01 00 00 00 00 02 29 03
					39 01 00 00 00 00 02 2A 00
					39 01 00 00 00 00 02 2B 00
					39 01 00 00 00 00 02 2C 00
					39 01 00 00 00 00 02 2D 00
					39 01 00 00 00 00 02 2E 00
					39 01 00 00 00 00 02 2F 00
					39 01 00 00 00 00 02 30 00
					39 01 00 00 00 00 02 31 00
					39 01 00 00 00 00 02 32 00
					39 01 00 00 00 00 02 33 00
					39 01 00 00 00 00 02 34 04
					39 01 00 00 00 00 02 35 00
					39 01 00 00 00 00 02 36 00
					39 01 00 00 00 00 02 37 00
					39 01 00 00 00 00 02 38 3C
					39 01 00 00 00 00 02 39 00
					39 01 00 00 00 00 02 3A 00
					39 01 00 00 00 00 02 3B 00
					39 01 00 00 00 00 02 3C 00
					39 01 00 00 00 00 02 3D 00
					39 01 00 00 00 00 02 3E 00
					39 01 00 00 00 00 02 3F 00
					39 01 00 00 00 00 02 40 00
					39 01 00 00 00 00 02 41 00
					39 01 00 00 00 00 02 42 00
					39 01 00 00 00 00 02 43 00
					39 01 00 00 00 00 02 44 00
					39 01 00 00 00 00 02 50 10
					39 01 00 00 00 00 02 51 32
					39 01 00 00 00 00 02 52 54
					39 01 00 00 00 00 02 53 76
					39 01 00 00 00 00 02 54 98
					39 01 00 00 00 00 02 55 BA
					39 01 00 00 00 00 02 56 10
					39 01 00 00 00 00 02 57 32
					39 01 00 00 00 00 02 58 54
					39 01 00 00 00 00 02 59 76
					39 01 00 00 00 00 02 5A 98
					39 01 00 00 00 00 02 5B BA
					39 01 00 00 00 00 02 5C DC
					39 01 00 00 00 00 02 5D FE
					39 01 00 00 00 00 02 5E 00
					39 01 00 00 00 00 02 5F 0E
					39 01 00 00 00 00 02 60 0F
					39 01 00 00 00 00 02 61 0C
					39 01 00 00 00 00 02 62 0D
					39 01 00 00 00 00 02 63 06
					39 01 00 00 00 00 02 64 07
					39 01 00 00 00 00 02 65 02
					39 01 00 00 00 00 02 66 02
					39 01 00 00 00 00 02 67 02
					39 01 00 00 00 00 02 68 02
					39 01 00 00 00 00 02 69 01
					39 01 00 00 00 00 02 6A 00
					39 01 00 00 00 00 02 6B 02
					39 01 00 00 00 00 02 6C 15
					39 01 00 00 00 00 02 6D 14
					39 01 00 00 00 00 02 6E 02
					39 01 00 00 00 00 02 6F 02
					39 01 00 00 00 00 02 70 02
					39 01 00 00 00 00 02 71 02
					39 01 00 00 00 00 02 72 02
					39 01 00 00 00 00 02 73 02
					39 01 00 00 00 00 02 74 02
					39 01 00 00 00 00 02 75 0E
					39 01 00 00 00 00 02 76 0F
					39 01 00 00 00 00 02 77 0C
					39 01 00 00 00 00 02 78 0D
					39 01 00 00 00 00 02 79 06
					39 01 00 00 00 00 02 7A 07
					39 01 00 00 00 00 02 7B 02
					39 01 00 00 00 00 02 7C 02
					39 01 00 00 00 00 02 7D 02
					39 01 00 00 00 00 02 7E 02
					39 01 00 00 00 00 02 7F 01
					39 01 00 00 00 00 02 80 00
					39 01 00 00 00 00 02 81 02
					39 01 00 00 00 00 02 82 14
					39 01 00 00 00 00 02 83 15
					39 01 00 00 00 00 02 84 02
					39 01 00 00 00 00 02 85 02
					39 01 00 00 00 00 02 86 02
					39 01 00 00 00 00 02 87 02
					39 01 00 00 00 00 02 88 02
					39 01 00 00 00 00 02 89 02
					39 01 00 00 00 00 02 8A 02
					39 01 00 00 00 00 04 FF 98 81 04
					39 01 00 00 00 00 02 6C 15
					39 01 00 00 00 00 02 6E 2A
					39 01 00 00 00 00 02 6F 33
					39 01 00 00 00 00 02 3B 98
					39 01 00 00 00 00 02 3A 94
					39 01 00 00 00 00 02 8D 14
					39 01 00 00 00 00 02 87 BA
					39 01 00 00 00 00 02 26 76
					39 01 00 00 00 00 02 B2 D1
					39 01 00 00 00 00 02 B5 06
					39 01 00 00 00 00 02 38 01
					39 01 00 00 00 00 02 39 00
					39 01 00 00 00 00 04 FF 98 81 01
					39 01 00 00 00 00 02 22 0A
					39 01 00 00 00 00 02 31 00
					39 01 00 00 00 00 02 53 7D
					39 01 00 00 00 00 02 55 8F
					39 01 00 00 00 00 02 40 33
					39 01 00 00 00 00 02 50 96
					39 01 00 00 00 00 02 51 96
					39 01 00 00 00 00 02 60 23
					39 01 00 00 00 00 02 A0 08
					39 01 00 00 00 00 02 A1 1D
					39 01 00 00 00 00 02 A2 2A
					39 01 00 00 00 00 02 A3 10
					39 01 00 00 00 00 02 A4 15
					39 01 00 00 00 00 02 A5 28
					39 01 00 00 00 00 02 A6 1C
					39 01 00 00 00 00 02 A7 1D
					39 01 00 00 00 00 02 A8 7E
					39 01 00 00 00 00 02 A9 1D
					39 01 00 00 00 00 02 AA 29
					39 01 00 00 00 00 02 AB 6B
					39 01 00 00 00 00 02 AC 1A
					39 01 00 00 00 00 02 AD 18
					39 01 00 00 00 00 02 AE 4B
					39 01 00 00 00 00 02 AF 20
					39 01 00 00 00 00 02 B0 27
					39 01 00 00 00 00 02 B1 50
					39 01 00 00 00 00 02 B2 64
					39 01 00 00 00 00 02 B3 39
					39 01 00 00 00 00 02 C0 08
					39 01 00 00 00 00 02 C1 1D
					39 01 00 00 00 00 02 C2 2A
					39 01 00 00 00 00 02 C3 10
					39 01 00 00 00 00 02 C4 15
					39 01 00 00 00 00 02 C5 28
					39 01 00 00 00 00 02 C6 1C
					39 01 00 00 00 00 02 C7 1D
					39 01 00 00 00 00 02 C8 7E
					39 01 00 00 00 00 02 C9 1D
					39 01 00 00 00 00 02 CA 29
					39 01 00 00 00 00 02 CB 6B
					39 01 00 00 00 00 02 CC 1A
					39 01 00 00 00 00 02 CD 18
					39 01 00 00 00 00 02 CE 4B
					39 01 00 00 00 00 02 CF 20
					39 01 00 00 00 00 02 D0 27
					39 01 00 00 00 00 02 D1 50
					39 01 00 00 00 00 02 D2 64
					39 01 00 00 00 00 02 D3 39
					39 01 00 00 00 00 04 FF 98 81 00
					05 01 00 00 78 00 02 11 00
					05 01 00 00 0A 00 02 29 00
					39 01 00 00 00 00 02 35 00
				];
				qcom,mdss-dsi-on-command-state = "dsi_lp_mode";
				qcom,mdss-dsi-off-command = [
					05 01 00 00 32 00 02 28 00
					05 01 00 00 78 00 02 10 00
				];
				qcom,mdss-dsi-off-command-state = "dsi_lp_mode";
			};
		};
	};
};