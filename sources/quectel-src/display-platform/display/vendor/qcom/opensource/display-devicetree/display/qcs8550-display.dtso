// SPDX-License-Identifier: BSD-3-Clause
/*
 * Copyright (c) 2024 Qualcomm Innovation Center, Inc. All rights reserved.
 */

/dts-v1/;
/plugin/;

#include "qcs8550-sde.dtsi"
#include "qcs8550-sde-display-aim300.dtsi"

/ {
	model = "Qualcomm Technologies, Inc. QCS8550 AIM300";
	compatible = "qcom,qcs8550-aim300", "qcom,qcs8550";
};